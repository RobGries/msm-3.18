## drivers/iio/humidity/Kconfig
```kconfig
#
# humidity sensor drivers
#
menu "Humidity sensors"

config DHT11
	tristate "DHT11 (and compatible sensors) driver"
	depends on GPIOLIB
	help
	  This driver supports reading data via a single interrupt
	  generating GPIO line. Currently tested are DHT11 and DHT22.
	  Other sensors should work as well as long as they speak the
	  same protocol.

config SI7005
	tristate "SI7005 relative humidity and temperature sensor"
	depends on I2C
	help
	  Say yes here to build support for the Silabs Si7005 relative
	  humidity and temperature sensor.

	  To compile this driver as a module, choose M here: the module
	  will be called si7005.


config HDC100X
	tristate "TI HDC100x relative humidity and temperature sensor"
	depends on I2C
	select IIO_BUFFER
	select IIO_TRIGGERED_BUFFER
	help
	  Say yes here to build support for the Texas Instruments
	  HDC1000, HDC1008, HDC1010, HDC1050, and HDC1080 relative
	  humidity and temperature sensors.

	  To compile this driver as a module, choose M here: the module
	  will be called hdc100x.



endmenu
```

## drivers/misc/cg5251/Kconfig
```kconfig
menu "Chipgoal ALS support (I2C)"

config CG5251_POLLING_MODE
	tristate "Chipgoal CG5251 polling mode"
	depends on I2C && SYSFS
endmenu
```
