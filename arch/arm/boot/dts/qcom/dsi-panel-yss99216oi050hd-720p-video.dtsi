/* Copyright (c) 2013, The Linux Foundation. All rights reserved.
 *
 * This program is free software; you can redistribute it and/or modify
 * it under the terms of the GNU General Public License version 2 and
 * only version 2 as published by the Free Software Foundation.
 *
 * This program is distributed in the hope that it will be useful,
 * but WITHOUT ANY WARRANTY; without even the implied warranty of
 * MERCHANTABILITY or FITNESS FOR A PARTICULAR PURPOSE.  See the
 * GNU General Public License for more details.
 */

/*---------------------------------------------------------------------------
 * This file is autogenerated file using gcdb parser. Please do not edit it.
 * Update input XML file to add a new entry or update variable in this file
 * VERSION = "1.0"
 *---------------------------------------------------------------------------*/
&mdss_mdp {
	dsi_yss99216oi050hd_720p_video: qcom,mdss_dsi_yss99216oi050hd_720p_video {
		qcom,mdss-dsi-panel-name = "YSs99216oi050hd 720p video mode dsi panel";
		qcom,mdss-dsi-panel-controller = <&mdss_dsi0>;
		qcom,mdss-dsi-panel-type = "dsi_video_mode";
		qcom,mdss-dsi-panel-destination = "display_1";
		qcom,mdss-dsi-panel-framerate = <60>;
		qcom,mdss-dsi-virtual-channel-id = <0>;
		qcom,mdss-dsi-stream = <0>;
		qcom,mdss-dsi-panel-width = <720>;
		qcom,mdss-dsi-panel-height = <1280>;
		qcom,mdss-dsi-h-front-porch = <60>;
		qcom,mdss-dsi-h-back-porch = <60>;
		qcom,mdss-dsi-h-pulse-width = <4>;
		qcom,mdss-dsi-h-sync-skew = <0>;
		qcom,mdss-dsi-v-back-porch = <20>;
		qcom,mdss-dsi-v-front-porch = <20>;
		qcom,mdss-dsi-v-pulse-width = <2>;
		qcom,mdss-dsi-h-left-border = <0>;
		qcom,mdss-dsi-h-right-border = <0>;
		qcom,mdss-dsi-v-top-border = <0>;
		qcom,mdss-dsi-v-bottom-border = <0>;
		qcom,mdss-dsi-bpp = <24>;
		qcom,mdss-dsi-color-order = "rgb_swap_rgb";
		qcom,mdss-dsi-underflow-color = <0xff>;
		qcom,mdss-dsi-border-color = <0>;
		qcom,mdss-dsi-on-command = [39 01 00 00 00 00 06 F0 55 AA 52 08 00
			39 01 00 00 00 00 05 FF AA 55 A5 80
			39 01 00 00 00 00 02 6F 13
			39 01 00 00 00 00 02 F7 00
			39 01 00 00 00 00 02 6F 01
			39 01 00 00 00 00 02 F3 00
			39 01 00 00 00 00 03 B1 78 21
			39 01 00 00 00 00 02 6F 02
			39 01 00 00 00 00 02 B8 08
			39 01 00 00 00 00 03 BC 00 00
			39 01 00 00 00 00 02 B6 01
			39 01 00 00 00 00 06 F0 55 AA 52 08 01
			39 01 00 00 00 00 03 B0 0d 0d
			39 01 00 00 00 00 03 B1 0d 0d
			39 01 00 00 00 00 02 CE 66
			39 01 00 00 00 00 02 C0 0C
			39 01 00 00 00 00 03 B5 06 06
			39 01 00 00 00 00 03 B6 05 05
			39 01 00 00 00 00 03 B7 05 05
			39 01 00 00 00 00 02 BE 33
			39 01 00 00 00 00 03 B3 26 26
			39 01 00 00 00 00 03 B4 19 19
			39 01 00 00 00 00 03 B9 46 46
			39 01 00 00 00 00 03 BA 23 23
			39 01 00 00 00 00 03 BC 70 00
			39 01 00 00 00 00 03 BD 70 00
			39 01 00 00 00 00 02 CA 00
			39 01 00 00 00 00 06 F0 55 AA 52 08 02
			39 01 00 00 00 00 02 EE 03
			39 01 00 00 00 00 11 B0 00 3C 00 4F 00 76 00 93 00 B9 00 D5 00 F4 01 27
			39 01 00 00 00 00 11 B1 01 47 01 87 01 B3 01 FE 02 37 02 3A 02 6E 02 A7
			39 01 00 00 00 00 11 B2 02 CB 02 F9 03 15 03 35 03 6A 03 A0 03 BB 03 D6
			39 01 00 00 00 00 05 B3 03 F1 03 FF
			39 01 00 00 00 00 11 B4 01 04 01 08 01 13 01 1E 01 2D 01 3B 01 4C 01 6B
			39 01 00 00 00 00 11 B5 01 81 01 B1 01 D5 02 14 02 48 02 4A 02 7A 02 B2
			39 01 00 00 00 00 11 B6 02 D6 03 05 03 25 03 4F 03 7D 03 AC 03 C3 03 DB
			39 01 00 00 00 00 05 B7 03 F3 03 FF
			39 01 00 00 00 00 11 B8 00 BF 00 C4 00 D3 00 E1 00 F4 01 06 01 1C 01 43
			39 01 00 00 00 00 11 B9 01 5E 01 96 01 BF 02 06 02 3E 02 40 02 73 02 AE
			39 01 00 00 00 00 11 BA 02 D3 03 09 03 32 03 A0 03 B9 03 D2 03 DE 03 EB
			39 01 00 00 00 00 05 BB 03 F8 03 FF
			39 01 00 00 00 00 06 F0 55 AA 52 08 06
			39 01 00 00 00 00 03 B0 2E 2E
			39 01 00 00 00 00 03 B1 2E 2E
			39 01 00 00 00 00 03 B2 2E 2E
			39 01 00 00 00 00 03 B3 2E 09
			39 01 00 00 00 00 03 B4 0B 23
			39 01 00 00 00 00 03 B5 1D 1F
			39 01 00 00 00 00 03 B6 11 17
			39 01 00 00 00 00 03 B7 13 19
			39 01 00 00 00 00 03 B8 01 03
			39 01 00 00 00 00 03 B9 2E 2E
			39 01 00 00 00 00 03 BA 2E 2E
			39 01 00 00 00 00 03 BB 02 00
			39 01 00 00 00 00 03 BC 18 12
			39 01 00 00 00 00 03 BD 16 10
			39 01 00 00 00 00 03 BE 1E 1C
			39 01 00 00 00 00 03 BF 22 0A
			39 01 00 00 00 00 03 C0 08 2E
			39 01 00 00 00 00 03 C1 2E 2E
			39 01 00 00 00 00 03 C2 2E 2E
			39 01 00 00 00 00 03 C3 2E 2E
			39 01 00 00 00 00 03 E5 25 24
			39 01 00 00 00 00 03 C4 2E 2E
			39 01 00 00 00 00 03 C5 2E 2E
			39 01 00 00 00 00 03 C6 2E 2E
			39 01 00 00 00 00 03 C7 2E 02
			39 01 00 00 00 00 03 C8 00 24
			39 01 00 00 00 00 03 C9 1E 1C
			39 01 00 00 00 00 03 CA 18 12
			39 01 00 00 00 00 03 CB 16 10
			39 01 00 00 00 00 03 CC 0A 08
			39 01 00 00 00 00 03 CD 2E 2E
			39 01 00 00 00 00 03 CE 2E 2E
			39 01 00 00 00 00 03 CF 09 0B
			39 01 00 00 00 00 03 D0 11 17
			39 01 00 00 00 00 03 D1 13 19
			39 01 00 00 00 00 03 D2 1D 1F
			39 01 00 00 00 00 03 D3 25 01
			39 01 00 00 00 00 03 D4 03 2E
			39 01 00 00 00 00 03 D5 2E 2E
			39 01 00 00 00 00 03 D6 2E 2E
			39 01 00 00 00 00 03 D7 2E 2E
			39 01 00 00 00 00 03 E6 22 23
			39 01 00 00 00 00 06 D8 00 00 00 00 00
			39 01 00 00 00 00 06 D9 00 00 00 00 00
			39 01 00 00 00 00 02 E7 00
			39 01 00 00 00 00 06 F0 55 AA 52 08 05
			39 01 00 00 00 00 02 ED 30
			39 01 00 00 00 00 06 F0 55 AA 52 08 03
			39 01 00 00 00 00 03 B0 20 00
			39 01 00 00 00 00 03 B1 20 00
			39 01 00 00 00 00 06 F0 55 AA 52 08 05
			39 01 00 00 00 00 03 B0 17 06
			39 01 00 00 00 00 02 B8 00
			39 01 00 00 00 00 06 BD 0F 03 03 00 03
			39 01 00 00 00 00 03 B1 17 06
			39 01 00 00 00 00 03 B9 00 03
			39 01 00 00 00 00 03 B2 17 06
			39 01 00 00 00 00 03 BA 00 03
			39 01 00 00 00 00 03 B3 17 06
			39 01 00 00 00 00 03 BB 00 00
			39 01 00 00 00 00 03 B4 17 06
			39 01 00 00 00 00 03 B5 17 06
			39 01 00 00 00 00 03 B6 17 06
			39 01 00 00 00 00 03 B7 17 06
			39 01 00 00 00 00 03 BC 00 01
			39 01 00 00 00 00 02 E5 06
			39 01 00 00 00 00 02 E6 06
			39 01 00 00 00 00 02 E7 06
			39 01 00 00 00 00 02 E8 06
			39 01 00 00 00 00 02 E9 0A
			39 01 00 00 00 00 02 EA 06
			39 01 00 00 00 00 02 EB 06
			39 01 00 00 00 00 02 EC 06
			39 01 00 00 00 00 06 F0 55 AA 52 08 05
			39 01 00 00 00 00 02 C0 07
			39 01 00 00 00 00 02 C1 05
			39 01 00 00 00 00 06 F0 55 AA 52 08 03
			39 01 00 00 00 00 06 B2 04 00 52 01 51
			39 01 00 00 00 00 06 B3 04 00 52 01 51
			39 01 00 00 00 00 06 F0 55 AA 52 08 05
			39 01 00 00 00 00 02 C4 82
			39 01 00 00 00 00 02 C5 80
			39 01 00 00 00 00 06 F0 55 AA 52 08 03
			39 01 00 00 00 00 06 B6 04 00 52 01 51
			39 01 00 00 00 00 06 B7 04 00 52 01 51
			39 01 00 00 00 00 06 F0 55 AA 52 08 05
			39 01 00 00 00 00 03 C8 03 20
			39 01 00 00 00 00 03 C9 01 21
			39 01 00 00 00 00 03 CA 03 20
			39 01 00 00 00 00 03 CB 07 20
			39 01 00 00 00 00 06 F0 55 AA 52 08 03
			39 01 00 00 00 00 02 C4 60
			39 01 00 00 00 00 02 C5 40
			39 01 00 00 00 00 06 F0 55 AA 52 08 03
			39 01 00 00 00 00 06 BA 44 00 60 01 72
			39 01 00 00 00 00 06 BB 44 00 60 01 72
			39 01 00 00 00 00 06 BC 53 00 03 00 48
			39 01 00 00 00 00 06 BD 53 00 03 00 48
			39 01 00 00 00 00 06 F0 55 AA 52 08 05
			39 01 00 00 00 00 0C D1 03 05 00 05 00 00 00 00 00 00 00
			39 01 00 00 00 00 0C D2 03 05 00 03 00 00 00 00 00 00 00
			39 01 00 00 00 00 0C D3 03 05 04 05 00 00 00 00 00 00 00
			39 01 00 00 00 00 0C D4 03 05 04 03 00 00 00 00 00 00 00
			39 01 00 00 00 00 06 F0 55 AA 52 08 03
			39 01 00 00 00 00 02 C4 40
			39 01 00 00 00 00 02 C5 40
			39 01 00 00 00 00 06 F0 55 AA 52 08 00
			39 01 00 00 00 00 02 6F 02
			39 01 00 00 00 00 02 B8 08
			39 01 00 00 00 00 02 35 00
#if 1
			05 01 00 00 78 00 01 11
			05 01 00 00 14 00 01 29];
#else
			39 01 00 00 00 00 06 F0 55 AA 52 08 00
			39 01 00 00 00 00 03 EF 07 3F
			39 01 00 00 00 00 05 EE 87 78 02 40];
#endif
		qcom,mdss-dsi-off-command = [05 01 00 00 32 00 02 28 00
					05 01 00 00 78 00 02 10 00];
		qcom,mdss-dsi-on-command-state = "dsi_lp_mode";
		qcom,mdss-dsi-off-command-state = "dsi_hs_mode";
		qcom,mdss-dsi-h-sync-pulse = <1>;
		qcom,mdss-dsi-traffic-mode = "burst_mode";
		qcom,mdss-dsi-lane-map = "lane_map_0123";
		qcom,mdss-dsi-bllp-eof-power-mode;
		qcom,mdss-dsi-bllp-power-mode;
		qcom,mdss-dsi-lane-0-state;
		qcom,mdss-dsi-lane-1-state;
		qcom,mdss-dsi-lane-2-state;
		qcom,mdss-dsi-lane-3-state;
		qcom,mdss-dsi-panel-timings = [7b 1a 10 00 3e 40 16 1c 15 03 04 00];
		qcom,mdss-dsi-t-clk-post = <0x0a>;
		qcom,mdss-dsi-t-clk-pre = <0x1c>;
		qcom,mdss-dsi-bl-min-level = <1>;
		qcom,mdss-dsi-bl-max-level = <4095>;
		qcom,mdss-dsi-dma-trigger = "trigger_sw";
		qcom,mdss-dsi-mdp-trigger = "none";
		qcom,mdss-dsi-bl-pmic-control-type = "bl_ctrl_wled";
		qcom,mdss-dsi-reset-sequence = <1 20>, <0 20>, <1 120>;
		qcom,mdss-pan-physical-width-dimension = <62>;
		qcom,mdss-pan-physical-height-dimension = <110>;
	};
};
